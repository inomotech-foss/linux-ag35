## drivers/quectel-drivers/Kconfig
```kconfig
#
# Optional quectel drivers configuration
#

menu "Quectel optional drivers"

config QUECTEL_DRIVER
	bool "quectel drivers"
	default y
	---help---
	  Quectel Drivers.

if QUECTEL_DRIVER

config LOW_POWER_CONSUME_V2
	tristate "low power consume driver v2(Not Recommend)"
	default m
	---help---
	  Low power consume driver v2, refer to KBA document.

config QL_LPM
	tristate "quectel lpm driver(Recommend)"
	default m
	---help---
	  Quectel lpm driver, refer to document.

config QTZONE
	bool "quectel trust zone support"
	default n
	---help---
	  Trust zone function, consult quectel engineer further.

config QTEE
	bool "Quectel QTEE Driver"
	default y
	---help---
	  Trust zone function, consult quectel engineer further.

config QSTART
	bool "QSTART"
	default y
	---help---
	  legacy

endif

endmenu
```
